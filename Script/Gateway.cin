/*@!Encoding:936*/
includes
{
//  #pragma library("../Script/mapping.dll")
//  #pragma library("D:\Test\CANoeProject\Script\DLL_Code\build\Release\mapping.dll")
  #pragma library("../Script/DLL_Code/build/Release/mapping.dll")
}

variables
{
//  struct pg_t
//  {
//    dword ID;
//    byte Priority;
//    dword PGN;    //分为(PF<240)PDU1{EDP\DP\PF}、(PF>240)PDU2{EDP\DP\PF\GE}
//    byte DA;      //PDU1时有效
//    byte SA;
//  };

  struct mapping_t
  {
    dword Multi_PG;
    dword C_PG;
    dword C_PG_Header;
  };
}

/***********************************************
*@function:ReadDataFromCSV
*@brief:读取CSV中的数据
*@param:[IN]  FilePath 文件路径
        [OUT] MappingArray 读出的数据数组
*@return: 0:读取失败 other:读取到的数据行数
***********************************************/
//int ReadMapFromCSV(char FilePath[], struct mapping_t MappingArray[])
int ReadMapFromCSV(char FilePath[])
{
  char p_data[100][100];
  char buffer_ascii[1000];
  int g_handle = 0;
  int j;
  dword i;
  struct mapping_t mapping;
  
  g_handle = openFileRead(FilePath,1);
  write("Read file: %s",FilePath);
  
  if(g_handle == 0)
  {
    write("文件打开失败!");
    return 0;
  }
  else
  {
    j = -1;
    mappingInit();
    while(fileGetStringSZ(buffer_ascii,elCount(buffer_ascii),g_handle)!=0)
    {
      if(j!=-1) //跳过第一行(表头)
      {
        spilt_string(buffer_ascii,p_data,",");
//        MappingArray[j].Multi_PG.ID = atol(p_data[0]);
//        MappingArray[j].Multi_PG.Priority = (MappingArray[j].Multi_PG.ID & 0x1c000000)>>26;
//        PF = (MappingArray[j].Multi_PG.ID & 0x00ff0000)>>16;
//        MappingArray[j].Multi_PG.PGN = PF < 0xF0 ? (MappingArray[j].Multi_PG.ID & 0x03ff0000)>>16 : (MappingArray[j].Multi_PG.ID & 0x03ffff00)>>8;
//        MappingArray[j].Multi_PG.DA = PF < 0xF0 ? (MappingArray[j].Multi_PG.ID & 0x0000ff00)>>8 : 0;
//        MappingArray[j].Multi_PG.SA = MappingArray[j].Multi_PG.ID & 0x000000ff;
//        
//        MappingArray[j].C_PG.ID = atol(p_data[1]);
//        MappingArray[j].C_PG.Priority = (MappingArray[j].C_PG.ID & 0x1c000000)>>26;
//        PF = (MappingArray[j].C_PG.ID & 0x00ff0000)>>16;
//        MappingArray[j].C_PG.PGN = PF < 0xF0 ? (MappingArray[j].C_PG.ID & 0x03ff0000)>>16 : (MappingArray[j].C_PG.ID & 0x03ffff00)>>8;
//        MappingArray[j].C_PG.DA = PF < 0xF0 ? (MappingArray[j].C_PG.ID & 0x0000ff00)>>8 : 0;
//        MappingArray[j].C_PG.SA = MappingArray[j].C_PG.ID & 0x000000ff;
        mapping.Multi_PG = atol(p_data[0]);
        mapping.C_PG = atol(p_data[1]);
        mapping.C_PG_Header = atol(p_data[2]);
        i = addMapping(mapping.Multi_PG,mapping.C_PG,mapping.C_PG_Header);
        testWaitForTimeout(1);
      }
      j++;
    }
    fileClose(g_handle);
    write("Mapping table size is %d",i);
//    i = findMapping(0x0C25FF2F,0xFe5a);
//    write("%x,%d",i,j);
    return j;
  }

}

/***********************************************
*@function:spilt_string
*@brief:分割字符串到数组
*@param:[IN]  input_string 被分割的字符串
        [OUT] out_string_arrary 分割后的字符串数组
        [IN] sign 分隔符
*@return: 分割后的数组长度
***********************************************/
int spilt_string(char input_string[],char out_string_arrary[][],char sign[])
{
    int i ;
    int debug;
    int StartIndexPos;
    char p_index[20];
    int  out_arrary_length ;
//    debug = 1;

    StartIndexPos = 0;
    out_arrary_length = 1;
    p_index[0] = 0;

    do{
         StartIndexPos =   strstr_off(input_string,StartIndexPos+1,sign);
         p_index[out_arrary_length] = StartIndexPos;
         if (StartIndexPos!=-1)
             out_arrary_length ++;
    } while(StartIndexPos!=-1);

     p_index[out_arrary_length] = strlen(input_string)-1;

    for(i=0;i<out_arrary_length;i++)
    {  
      if(i==0 && p_index[i+1] -  p_index[i] == 1){
        substr_cpy(out_string_arrary[i], input_string, p_index[i],  p_index[i+1] -  p_index[i], elcount(out_string_arrary[i]));
      }
      else if(i==0){
        substr_cpy(out_string_arrary[i], input_string, p_index[i],  p_index[i+1] -  p_index[i], elcount(out_string_arrary[i]));
      }
      else if(i==out_arrary_length-1){
        substr_cpy(out_string_arrary[i], input_string, p_index[i]+1,  p_index[i+1] -  p_index[i], elcount(out_string_arrary[i]));  
      }
      else{
        substr_cpy(out_string_arrary[i], input_string, p_index[i]+1 ,  p_index[i+1] -  p_index[i] -1, elcount(out_string_arrary[i]));
      }

//      if (debug){
//       write("serched postion:%d", p_index[i]);
//       write("out_string_arrary[%d]:%s", i,out_string_arrary[i]);
//      }
    }

  return out_arrary_length;
}