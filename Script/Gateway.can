/*@!Encoding:936*/
/*@!Encoding:936*/
includes
{

}

variables
{ 
  byte Source_Channel = 1;
  byte Target_Channel = 2;
}

/**
 * @brief 将两个通道的数据透传，但其中有一些字节做修改
 * 
 * @param 
 * @param 
 * 
 * @note
 * 1. 
 * 2. 
 * 3. 
 */
on message *
{
  message 0x0 temp[1];
  if(this.can == Source_Channel)
  {
    if(!(this.msgflags & 0x40))
    {
      temp[0] = this;
      temp[0].id = this.id;
      temp[0].can = Target_Channel;
//      write("ch = %d, MsgFlags = %1X",this.can,this.MsgFlags);
      if(temp[0].id == 0x00)
      {
        //这里面写某个ID的报文需要处理的逻辑
      }
      output(temp[0]);
    }
  }
  if(this.can == Target_Channel)
  {
    if(!(this.msgflags & 0x40))
    {
      temp[0] = this;
      temp[0].id = this.id;
      temp[0].can = Source_Channel;
//      write("ch = %d, MsgFlags = %1X",this.can,this.MsgFlags);
      if(temp[0].id == 0x00)
      {
        //这里面写某个ID的报文需要处理的逻辑
      }
      output(temp[0]);
    }
  }
  
}

MainTest()
{
  testWaitForTimeout(0);
}
